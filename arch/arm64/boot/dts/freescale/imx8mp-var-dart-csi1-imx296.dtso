// SPDX-License-Identifier: GPL-2.0-or-later OR MIT
/*
 * Copyright 2023 Ideas on Board Oy
 */

/dts-v1/;
/plugin/;

#define CSI		mipi_csi_1
#define CSI_EP		mipi_csi_1_in
#define I2C_BUS		i2c4
#define IMX296_EP	imx296_1_out
#define VC_CTRL		vc_ctrl_1

#include "imx8mp-var-dart-imx296.dtsi"
